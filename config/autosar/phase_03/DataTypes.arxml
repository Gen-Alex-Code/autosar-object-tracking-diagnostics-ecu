AUTOSAR XML (schema 4.0)
package /DataTypes
  7 x impl type:
    SensorQuality_T: category=VALUE
    SensorSourceStatus_T: category=VALUE
    TrackingState_T: category=VALUE
    ObjectCandidate_T: category=STRUCTURE
    ObjectCandidateList_T: category=STRUCTURE
    TrackedObjectStatus_T: category=STRUCTURE
    TrackingDiagnosticSnapshot_T: category=STRUCTURE
