AUTOSAR XML (schema 4.0)
package /Interfaces
  sender receiver interface ObjectCandidateList_I
  sender receiver interface TrackedObjectStatus_I
  sender receiver interface ObjectAlertOutput_I
  client server interface DiagnosticEvent_I
    operation ReportDiagnosticEvent
  client server interface DiagnosticCounter_I
    operation IncrementCounter
    operation ReadCounter
  client server interface TrackingDiagnosticRead_I
    operation ReadTrackingStatus
    operation ReadLastObjectConfidence
    operation ReadTrackingSnapshot
