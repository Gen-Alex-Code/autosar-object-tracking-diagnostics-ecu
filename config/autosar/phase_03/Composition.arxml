AUTOSAR XML (schema 4.0)
package /Composition
  composition sw component type ObjectTrackingDiagnosticsComposition
    component SensorInput
    component ObjectTracker
    assembly sw connector SensorInput_To_ObjectTracker_CandidateList
