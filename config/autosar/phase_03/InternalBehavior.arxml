AUTOSAR XML (schema 4.0)
package /InternalBehavior
  behavior SensorInputSWC_InternalBehavior
    runnable SensorInput_MainCycle
    timing event EVT_10MS_SENSOR_INPUT: period=0.01
  behavior ObjectTrackerSWC_InternalBehavior
    runnable ObjectTracker_MainCycle
    runnable ObjectTracker_DiagnosticRead
    timing event EVT_10MS_OBJECT_TRACKER: period=0.01
    operation invoked event EVT_DIAG_READ_TRACKER_DATA
